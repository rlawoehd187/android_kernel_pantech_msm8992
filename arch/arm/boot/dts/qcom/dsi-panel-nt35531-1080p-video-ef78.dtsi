/*
 * Copyright (c) 2015, The Linux Foundation. All rights reserved.
 *
 * This program is free software; you can redistribute it and/or modify
 * it under the terms of the GNU General Public License version 2 and
 * only version 2 as published by the Free Software Foundation.
 *
 * This program is distributed in the hope that it will be useful,
 * but WITHOUT ANY WARRANTY; without even the implied warranty of
 * MERCHANTABILITY or FITNESS FOR A PARTICULAR PURPOSE.  See the
 * GNU General Public License for more details.
 */

/* Novatek NT35531 1080p video mode panel of the Pantech EF78S */

&mdss_mdp {

	qcom,mdss_dsi_nt35531_1080p_video_ef78 {
		qcom,mdss-dsi-panel-name = "nt35531 1080p video mode dsi panel";
		qcom,mdss-dsi-panel-controller = <&mdss_dsi0>;
		qcom,mdss-dsi-panel-type = "dsi_video_mode";
		qcom,mdss-dsi-panel-destination = "display_1";
		qcom,mdss-dsi-panel-framerate = <0x3c>;
		qcom,mdss-dsi-virtual-channel-id = <0x0>;
		qcom,mdss-dsi-stream = <0x0>;
		qcom,mdss-dsi-panel-width = <0x438>;
		qcom,mdss-dsi-panel-height = <0x780>;
		qcom,mdss-dsi-h-front-porch = <0x83>;
		qcom,mdss-dsi-h-back-porch = <0x18>;
		qcom,mdss-dsi-h-pulse-width = <0x6>;
		qcom,mdss-dsi-h-sync-skew = <0x0>;
		qcom,mdss-dsi-v-back-porch = <0x7>;
		qcom,mdss-dsi-v-front-porch = <0xd>;
		qcom,mdss-dsi-v-pulse-width = <0x2>;
		qcom,mdss-dsi-h-left-border = <0x0>;
		qcom,mdss-dsi-h-right-border = <0x0>;
		qcom,mdss-dsi-v-top-border = <0x0>;
		qcom,mdss-dsi-v-bottom-border = <0x0>;
		qcom,mdss-dsi-bpp = <0x18>;
		qcom,mdss-dsi-underflow-color = <0xff>;
		qcom,mdss-dsi-border-color = <0x0>;
		qcom,mdss-dsi-on-command = [15 01 00 00 00 00 02 ff 10 39 01 00 00 00 00 06 3b 03 09 0d 1e 83 15 01 00 00 00 00 02 b0 00 15 01 00 00 00 00 02 bb 03 15 01 00 00 00 00 02 d9 00 15 01 00 00 00 00 02 e5 00 15 01 00 00 00 00 02 ff e0 15 01 00 00 00 00 02 fb 01 15 01 00 00 00 00 02 1f 70 15 01 00 00 00 00 02 9e 03 15 01 00 00 00 00 02 ff 10 15 01 00 00 00 00 02 35 00 15 01 00 00 00 00 02 51 80 15 01 00 00 00 00 02 53 24 15 01 00 00 00 00 02 55 00 05 01 00 00 64 00 01 11 05 01 00 00 78 00 01 29];
		qcom,mdss-dsi-off-command = [05 01 00 00 32 00 02 28 00 05 01 00 00 78 00 02 10 00];
		qcom,mdss-dsi-on-command-state = "dsi_lp_mode";
		qcom,mdss-dsi-off-command-state = "dsi_hs_mode";
		qcom,mdss-dsi-h-sync-pulse = <0x0>;
		qcom,mdss-dsi-traffic-mode = "non_burst_sync_event";
		qcom,mdss-dsi-bllp-eof-power-mode;
		qcom,mdss-dsi-bllp-power-mode;
		qcom,mdss-dsi-lane-0-state;
		qcom,mdss-dsi-lane-1-state;
		qcom,mdss-dsi-lane-2-state;
		qcom,mdss-dsi-lane-3-state;
		qcom,mdss-dsi-panel-timings = <0xe7362400 0x666a2a3a 0x2d030400>;
		qcom,mdss-dsi-t-clk-post = <0x3>;
		qcom,mdss-dsi-t-clk-pre = <0x2b>;
		qcom,mdss-dsi-bl-min-level = <0x1>;
		qcom,mdss-dsi-bl-max-level = <0xd8>;
		qcom,mdss-dsi-dma-trigger = "trigger_sw";
		qcom,mdss-dsi-mdp-trigger = "none";
		qcom,mdss-dsi-bl-pmic-control-type = "bl_ctrl_dcs";
		qcom,mdss-dsi-reset-sequence = <0x1 0x14 0x0 0x1 0x1 0x14>;
	};
};
